## examples/esp-album/components/esp32_p4_function_ev_board/Kconfig
```kconfig
menu "Board Support Package(ESP32-P4)"

    config BSP_ERROR_CHECK
        bool "Enable error check in BSP"
        default y
        help
            Error check assert the application before returning the error code.
            
    menu "I2C"
        config BSP_I2C_NUM
            int "I2C peripheral index"
            default 1
            range 0 1
            help
                ESP32P4 has two I2C peripherals, pick the one you want to use.

        config BSP_I2C_FAST_MODE
            bool "Enable I2C fast mode"
            default y
            help
                I2C has two speed modes: normal (100kHz) and fast (400kHz).

        config BSP_I2C_CLK_SPEED_HZ
            int
            default 400000 if BSP_I2C_FAST_MODE
            default 100000
    endmenu

    menu "I2S"
        config BSP_I2S_NUM
            int "I2S peripheral index"
            default 1
            range 0 2
            help
                ESP32P4 has three I2S peripherals, pick the one you want to use.
    endmenu

    menu "uSD card - Virtual File System"
        config BSP_SD_FORMAT_ON_MOUNT_FAIL
            bool "Format uSD card if mounting fails"
            default n
            help
                The SDMMC host will format (FAT) the uSD card if it fails to mount the filesystem.

        config BSP_SD_MOUNT_POINT
            string "uSD card mount point"
            default "/sdcard"
            help
                Mount point of the uSD card in the Virtual File System

    endmenu

    menu "SPIFFS - Virtual File System"
        config BSP_SPIFFS_FORMAT_ON_MOUNT_FAIL
            bool "Format SPIFFS if mounting fails"
            default n
            help
                Format SPIFFS if it fails to mount the filesystem.

        config BSP_SPIFFS_MOUNT_POINT
            string "SPIFFS mount point"
            default "/spiffs"
            help
                Mount point of SPIFFS in the Virtual File System.

        config BSP_SPIFFS_PARTITION_LABEL
            string "Partition label of SPIFFS"
            default "storage"
            help
                Partition label which stores SPIFFS.

        config BSP_SPIFFS_MAX_FILES
            int "Max files supported for SPIFFS VFS"
            default 5
            help
                Supported max files for SPIFFS in the Virtual File System.
    endmenu

    menu "Display"
        config BSP_LCD_DPI_BUFFER_NUMS
            int "Set number of frame buffers"
            default 1
            range 1 3
            help
                Let DPI LCD driver create a specified number of frame-size buffers. Only when it is set to multiple can the avoiding tearing be turned on.

        config BSP_DISPLAY_LVGL_AVOID_TEAR
            bool "Avoid tearing effect"
            depends on BSP_LCD_DPI_BUFFER_NUMS > 1
            default "n"
            help
                Avoid tearing effect through LVGL buffer mode and double frame buffers of RGB LCD. This feature is only available for RGB LCD.

        choice BSP_DISPLAY_LVGL_MODE
            depends on BSP_DISPLAY_LVGL_AVOID_TEAR
            prompt "Select LVGL buffer mode"
            default BSP_DISPLAY_LVGL_FULL_REFRESH
            config BSP_DISPLAY_LVGL_FULL_REFRESH
                bool "Full refresh"
            config BSP_DISPLAY_LVGL_DIRECT_MODE
                bool "Direct mode"
        endchoice
            
        config BSP_DISPLAY_BRIGHTNESS_LEDC_CH
        int "LEDC channel index"
        default 1
        range 0 7
        help
            LEDC channel is used to generate PWM signal that controls display brightness.
            Set LEDC index that should be used.

        choice BSP_LCD_COLOR_FORMAT
            prompt "Select LCD color format"
            default BSP_LCD_COLOR_FORMAT_RGB565
            help
                Select the LCD color format RGB565/RGB888.

            config BSP_LCD_COLOR_FORMAT_RGB565
                bool "RGB565"
            config BSP_LCD_COLOR_FORMAT_RGB888
                bool "RGB888"
        endchoice   
            
        choice BSP_LCD_TYPE
            prompt "Select LCD type"
            default BSP_LCD_TYPE_1024_600
            help
                Select the LCD.

            config BSP_LCD_TYPE_1024_600
                bool "LCD 7-inch 1024x600 - ek79007"
            config BSP_LCD_TYPE_1280_800
                bool "LCD 1280x800 - ili9881c"
            config BSP_LCD_TYPE_JD9366_800_1280
                bool "LCD 800x1280 - jd9366 (integrated touch)"
                help
                    JD9366 LCD controller with integrated touch controller
        endchoice

        menu "Touch Controller"
            config BSP_TOUCH_ENABLED
                bool "Enable touch controller"
                default y
                help
                    Enable touch controller support for the LCD panel.

            choice BSP_TOUCH_CONTROLLER
                prompt "Select touch controller"
                default BSP_TOUCH_GT911 if !BSP_LCD_TYPE_JD9366_800_1280
                default BSP_TOUCH_JD9366 if BSP_LCD_TYPE_JD9366_800_1280
                depends on BSP_TOUCH_ENABLED
                help
                    Select the touch controller type.

                config BSP_TOUCH_GT911
                    bool "GT911 Touch Controller"
                    depends on !BSP_LCD_TYPE_JD9366_800_1280
                    help
                        Use GT911 touch controller (default for ESP32-P4 Function EV Board).

                config BSP_TOUCH_JD9366
                    bool "JD9366 Touch Controller" 
                    help
                        Use JD9366 touch controller (integrated with JD9366 LCD controller).
            endchoice

            config BSP_TOUCH_I2C_ADDRESS
                hex "Touch controller I2C address"
                default 0x5d if BSP_TOUCH_GT911
                default 0x68 if BSP_TOUCH_JD9366
                depends on BSP_TOUCH_ENABLED
                help
                    I2C address of the touch controller.
                    GT911: 0x5d or 0x14
                    JD9366: 0x68

        endmenu           
        
    endmenu
    
endmenu
```

## versions/YDP1010BT006-V1/examples/esp-album/main/Kconfig.projbuild
```kconfig
menu "Digital Photo Album Configuration"
    menu "WiFi File Server Configuration"

        config WIFI_FILE_SERVER_ENABLED
            bool "Enable WiFi File Server"
            default y
            help
                Enable WiFi hotspot and HTTP file server functionality.
                This allows wireless access to files through a web browser.

        config WIFI_AP_SSID
            string "WiFi AP SSID"
            default "PhotoAlbum_WiFi"
            depends on WIFI_FILE_SERVER_ENABLED
            help
                Set the WiFi Access Point SSID name.

        config WIFI_AP_PASSWORD
            string "WiFi AP Password"
            default "12345678"
            depends on WIFI_FILE_SERVER_ENABLED
            help
                Set the WiFi Access Point password (minimum 8 characters).

        config WIFI_AP_MAX_CLIENTS
            int "Maximum WiFi clients"
            range 1 8
            default 4
            depends on WIFI_FILE_SERVER_ENABLED
            help
                Maximum number of clients that can connect to the WiFi hotspot.

    endmenu

    menu "Audio Decoder Configuration"

        config AUDIO_DEC_FLAC_ENABLE
            bool "Enable FLAC Decoder"
            default n
            help
                Enable FLAC audio decoder support.
                FLAC (Free Lossless Audio Codec) is a lossless audio compression format.

        config AUDIO_DEC_OPUS_ENABLE
            bool "Enable OPUS Decoder"
            default n
            help
                Enable OPUS audio decoder support.
                Opus is a lossy audio coding format developed for internet streaming.

        config AUDIO_DEC_VORBIS_ENABLE
            bool "Enable VORBIS Decoder"
            default n
            help
                Enable Vorbis audio decoder support.
                Vorbis is a free and open-source lossy audio compression format.

        config AUDIO_DEC_ADPCM_ENABLE
            bool "Enable ADPCM Decoder"
            default n
            help
                Enable ADPCM (Adaptive Differential Pulse Code Modulation) audio decoder support.
                ADPCM is a variant of PCM that encodes the differences between samples.

    endmenu

    menu "Video Synchronization Configuration"

        config HDMI_VIDEO_SYNC_ENABLED
            bool "Enable Audio-Video Synchronization"
            default y
            help
                Enable synchronization between audio and video playback.
                This ensures audio and video tracks are played in sync.
                When disabled, audio and video will play independently without timing coordination.

    endmenu

endmenu
```
